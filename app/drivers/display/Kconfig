## app/drivers/display/Kconfig
```kconfig
# Copyright (c) 2021 The ZMK Contributors
# SPDX-License-Identifier: MIT

if DISPLAY

rsource "Kconfig.il0323"
rsource "Kconfig.gc9a01a"

endif # DISPLAY
```

## boards/shields/display-128/Kconfig.defconfig
```kconfig
# Copyright (c) 2024 The ZMK Contributors
# SPDX-License-Identifier: MIT

config SHIELD_DISPLAY_128
    bool "Enable 1.28 LCD"

config ZMK_DISPLAY_STATUS_SCREEN_CUSTOM
    select LV_USE_IMG

if SHIELD_DISPLAY_128

choice ZMK_DISPLAY_STATUS_SCREEN
    default ZMK_DISPLAY_STATUS_SCREEN_CUSTOM
endchoice

config ZMK_DISPLAY_STATUS_SCREEN_CUSTOM
    select LV_USE_LABEL
    select LV_USE_IMG
    select LV_USE_CANVAS
    select LV_USE_ANIMIMG 
    select LV_USE_ANIMATION
    select LV_USE_LINE 
    select LV_FONT_UNSCII_8

config ZMK_DONGLE_DISPLAY_DONGLE_BATTERY
    bool "Show also the battery level of the dongle"
    default n

#    depends on BT && (!ZMK_SPLIT_BLE || ZMK_SPLIT_ROLE_CENTRAL)

if !ZMK_SPLIT || ZMK_SPLIT_ROLE_CENTRAL

config ZMK_DISPLAY_STATUS_SCREEN_CUSTOM
    select LV_FONT_MONTSERRAT_24
    select ZMK_WPM

endif # !ZMK_SPLIT || ZMK_SPLIT_ROLE_CENTRAL
  
# 主手 - OLED朝向, 0=0, 1=90, 2=180, 3=270
config ZMK_KYDISPLAY_CENTRAL_OLED_ORIENTATION 
    int "Choose the orientation  of central halve oled"
    default 0

#config CONFIG_ZMK_WIDGET_BATTERY_STATUS_SHOW_PERIPHERAL
#   default y

choice ZMK_DISPLAY_WORK_QUEUE
    default ZMK_DISPLAY_WORK_QUEUE_DEDICATED
endchoice

config GC9A01A
    bool "Use GC9A01A Dirve For 1.28 LCD"
    default y

config LV_Z_MEM_POOL_SIZE
    default 8192

config LV_Z_VDB_SIZE
    default 64

config LV_DPI_DEF
    default 148

config LV_Z_BITS_PER_PIXEL
    default 1

choice LV_COLOR_DEPTH
    default LV_COLOR_DEPTH_16
endchoice

endif
```

## boards/shields/nano_v2_test/Kconfig.defconfig
```kconfig
# Copyright (c) 2023 The ZMK Contributors
# SPDX-License-Identifier: MIT

if SHIELD_NANO_V2_TEST

config ZMK_KEYBOARD_NAME
    default "nano_v2_test"

config ZMK_RGB_UNDERGLOW
    select WS2812_STRIP
    select SPI


if ZMK_DISPLAY

config ZMK_DONGLE_DISPLAY_DONGLE_BATTERY
    bool "Show also the battery level of the dongle"
    default n

config GC9A01A
    bool "Use GC9A01A Dirve For 1.28 LCD"
    default y

# 主手 - OLED朝向, 0=0, 1=90, 2=180, 3=270
config ZMK_KYDISPLAY_CENTRAL_OLED_ORIENTATION 
    int "Choose the orientation  of central halve oled"
    default 0

endif # ZMK_DISPLAY
endif
```

## boards/shields/nano_v2_test/Kconfig.shield
```kconfig
# Copyright (c) 2023 The ZMK Contributors
# SPDX-License-Identifier: MIT

config SHIELD_NANO_V2_TEST
    def_bool $(shields_list_contains,nano_v2_test)
```

## config/west.yml
```yaml
# manifest:
#   remotes:
#     - name: zmkfirmware
#       url-base: https://github.com/zmkfirmware
#   projects:
#     - name: zmk
#       remote: zmkfirmware
#       revision: main
#       import: app/west.yml
#   self:
#     path: config


manifest:
  remotes:
    - name: zmkfirmware
      # url-base: https://github.com/zmkfirmware
      url-base: https://github.com/petejohanson  # 添加鼠标的修订
    # Additional modules containing boards/shields/custom code can be listed here as well
    # See https://docs.zephyrproject.org/3.2.0/develop/west/manifest.html#projects
    - name: kawvin                            # <--- add this
      url-base: https://github.com/kawvin     # <--- and this
  projects:
    - name: zmk
      remote: zmkfirmware
      # revision: main
      revision: feat/pointers-move-scroll  # 添加鼠标的修订
      import: app/west.yml
    - name: gc9a01a_zephyr_driver                 # <--- and these
      remote: kawvin                          # <---
      revision: main                              # <---
  self:
    path: config
```

## drivers/display/Kconfig.bak
```kconfig
# Copyright (c) 2021 The ZMK Contributors
# SPDX-License-Identifier: MIT

if DISPLAY

rsource "Kconfig.il0323"
rsource "Kconfig.lpm009m360a"
rsource "Kconfig.gc9a01a"

endif # DISPLAY
```
